## arch/arm64/configs/bg6_defconfig
```kconfig
CONFIG_CORESIGHT=y
CONFIG_CORESIGHT_LINKS_AND_SINKS=y
CONFIG_CORESIGHT_LINK_AND_SINK_TMC=y
# CONFIG_CORESIGHT_CATU is not set
# CONFIG_CORESIGHT_SINK_TPIU is not set
# CONFIG_CORESIGHT_SINK_ETBV10 is not set
CONFIG_CORESIGHT_SOURCE_ETM4X=y
CONFIG_CORESIGHT_APETB=y
CONFIG_CORESIGHT_STM=y
# CONFIG_CORESIGHT_CPU_DEBUG is not set
# CONFIG_CORESIGHT_TMC_GROUP is not set

#
# Coresight Physical Layer drivers
#
# CONFIG_SPRD_SHARKL6PRO_CORESIGHT_PHY is not set
# end of Coresight Physical Layer drivers
# end of Kernel hacking
# ReSukiSU
CONFIG_KSU=y
CONFIG_KSU_MANUAL_HOOK=y

# QSFWSZ in-tree diagnostic interface
CONFIG_QSFWSZ=y
```

## drivers/Kconfig
```kconfig
source "drivers/nfc/Kconfig"
source "drivers/kernelsu/Kconfig"
source "drivers/qsfwsz/Kconfig"
endmenu
```

## drivers/qsfwsz/Kconfig
```kconfig
# SPDX-License-Identifier: GPL-2.0

config QSFWSZ
	bool "QSFWSZ kernel diagnostic interface"
	select MISC_DEVICES
	default n
	help
	  Build the QSFWSZ diagnostic miscdevice at /dev/qsfwsz.
	  The current ABI exposes driver metadata only. It does not provide
	  cross-process memory access or memory modification.
```
